## boards/shields/venturi48/Kconfig.defconfig
```kconfig
if SHIELD_VENTURI_LEFT

config ZMK_KEYBOARD_NAME
    default "Venturi48"

config ZMK_SPLIT_ROLE_CENTRAL
    default y

endif

if SHIELD_VENTURI_LEFT || SHIELD_VENTURI_RIGHT

config ZMK_SPLIT
    default y

endif
```

## boards/shields/venturi48/Kconfig.shield
```kconfig
config SHIELD_VENTURI_LEFT
    def_bool $(shields_list_contains,venturi_left)

config SHIELD_VENTURI_RIGHT
    def_bool $(shields_list_contains,venturi_right)
    
```
